## xen/arch/riscv/Kconfig
```kconfig
config RISCV
	def_bool y
	select HAS_PDX
	select HAS_PASSTHROUGH
	select HAS_DEVICE_TREE

config RISCV_64
	def_bool y
	select 64BIT

config ARCH_DEFCONFIG
	string
	default "arch/riscv/configs/riscv64_defconfig" if RISCV_64

menu "Architecture Features"

source "arch/Kconfig"

endmenu

menu "ISA Selection"

choice
	prompt "Base ISA"
	default RISCV_ISA_RV64IMA if RISCV_64
	help
	  This selects the base ISA extensions that Xen will target.

config RISCV_ISA_RV64IMA
	bool "RV64IMA"
	help
	  Use the RV64I base ISA, plus the "M" and "A" extensions
	  for integer multiply/divide and atomic instructions, respectively.

endchoice

config RISCV_ISA_C
	bool "Compressed extension"
	default y
	help
	  Add "C" to the ISA subsets that the toolchain is allowed to
	  emit when building Xen, which results in compressed instructions
	  in the Xen binary.

	  If unsure, say Y.
endmenu

source "arch/riscv/platforms/Kconfig"

source "common/Kconfig"

source "drivers/Kconfig"
```

## xen/arch/riscv/configs/riscv64_defconfig
```kconfig
CONFIG_RISCV=y
CONFIG_RISCV_64=y
CONFIG_64BIT=y
CONFIG_NR_CPUS=1
CONFIG_RISCV_ISA_RV64IMA=y
CONFIG_RISCV_ISA_C=y
CONFIG_HVM=y
CONFIG_QEMU=y
CONFIG_HAS_DEVICE_TREE=y
CONFIG_HAS_PDX=y
CONFIG_SCHED_CREDIT=y
CONFIG_SCHED_CREDIT_DEFAULT=y
CONFIG_SCHED_DEFAULT="credit"
CONFIG_CMDLINE=""
CONFIG_DOM0_MEM=""
CONFIG_DTB_FILE=""
CONFIG_HAS_NS16550=y
CONFIG_HAS_PASSTHROUGH=y
CONFIG_EXPERT=y
CONFIG_GRANT_TABLE=n
CONFIG_HYPFS=n
CONFIG_UNSUPPORTED=y
CONFIG_DEBUG=y
CONFIG_DEBUG_INFO=y
```
